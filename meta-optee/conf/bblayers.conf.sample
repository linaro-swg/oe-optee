## meta-optee/conf/bblayers.conf.sample
```bitbake
# LAYER_CONF_VERSION is increased each time build/conf/bblayers.conf
# changes incompatibly
LCONF_VERSION = "5"

BBPATH = "${TOPDIR}"
BBFILES ?= ""

BBLAYERS ?= " \
  ##OEROOT##/meta \
  ##OEROOT##/../meta-optee \
  ##OEROOT##/../meta-openembedded/meta-oe \
  "

BBLAYERS_NON_REMOVABLE ?= " \
  ##OEROOT##/openembedded-core/meta \
  "
```

## meta-optee/conf/layer.conf
```bitbake
# We have a conf and classes directory, add to BBPATH
BBPATH .= ":${LAYERDIR}"
# We have recipes-* directories add to bbfiles
BBFILES += "${LAYERDIR}/recipes-*/*/*.bb"

BBFILE_COLLECTIONS += "optee"
BBFILE_PATTERN_optee = "^${LAYERDIR}/"
BBFILE_PRIORITY_optee = "10"

BBLAYERS_LAYERINDEX_NAME_optee = "optee"
```

## meta-optee/conf/machine/fvp-optee64.conf
```bitbake
# A machine for testing optee 64-bit within FVP.

require conf/machine/include/arm/arch-armv8.inc

KERNEL_IMAGETYPE = "Image"
IMAGE_FSTYPES += "cpio.gz"
PREFERRED_PROVIDER_virtual/kernel ?= "linux-optee"
```

## meta-optee/conf/machine/hikey-optee64.conf
```bitbake
# A machine for testing optee 64-bit on the Hikey 96board.

require conf/machine/include/arm/arch-armv8.inc

KERNEL_IMAGETYPE = "Image"
IMAGE_FSTYPES += "cpio.gz"
PREFERRED_PROVIDER_virtual/kernel ?= "linux-optee"

MACHINE_FEATURES = "efi"

SERIAL_CONSOLES = "115200;ttyAMA3"
```

## meta-optee/conf/machine/qemu-optee32.conf
```bitbake
# A machine specially configured for optee 32-bit testing.

require conf/machine/include/qemu.inc
require conf/machine/include/tune-cortexa15.inc

KERNEL_IMAGETYPE = "zImage"
SERIAL_CONSOLES = "115200;ttyAMA0 115200;ttyAMA1"

IMAGE_FSTYPES += "bios"
PREFERRED_PROVIDER_virtual/kernel ?= "linux-optee"

EXTRA_IMAGEDEPENDS += "soc-term-native"
```
